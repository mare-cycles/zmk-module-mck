## Kconfig
```kconfig
menu "MCK (zmk-module-mck)"

config MCK_DEVICE
    bool "MCK device info (model, connection, battery) for MCK Aquarium"

if MCK_DEVICE

config MCK_DEVICE_STUDIO_RPC
    bool "Answer MCK device info over the custom ZMK Studio RPC (mck__device)"
    depends on ZMK_STUDIO
    default y

config MCK_DEVICE_MODEL
    string "Model name reported to MCK Aquarium (e.g. MCK-02)"
    default ""

config MCK_DEVICE_BOARD_REVISION
    string "Board revision reported to MCK Aquarium (e.g. rev1)"
    default ""

config MCK_DEVICE_NOTIFY_DELAY_MS
    int "Wait before sending a status notification, to merge bursts of changes (ms)"
    default 250

endif # MCK_DEVICE

config MCK_SETTINGS
    bool "MCK runtime settings (battery type, idle / sleep), kept in flash"
    depends on SETTINGS
    help
      Settings MCK Aquarium can change through mck__device: the battery type
      of the mck,aaa-battery driver and (with MCK_SETTINGS_POWER) ZMK's idle
      and deep sleep times. Enable on every half of a split keyboard.

if MCK_SETTINGS

config MCK_SETTINGS_POWER
    bool "Idle / sleep times can be changed at runtime"
    help
      Needs zmk_activity_set_idle_ms() / zmk_activity_set_sleep_ms(), which
      are in cormoran's ZMK branch main+dya (not in ZMK v0.3 / main).

config MCK_SETTINGS_SPLIT_RELAY
    bool "Send settings changes from the split central to the peripherals"
    depends on ZMK_SPLIT && ZMK_SPLIT_RELAY_EVENT
    default y

endif # MCK_SETTINGS

DT_COMPAT_MCK_AAA_BATTERY := mck,aaa-battery

config MCK_AAA_BATTERY
    bool "AAA (NiMH) battery level from a voltage divider"
    default $(dt_compat_enabled,$(DT_COMPAT_MCK_AAA_BATTERY))
    depends on SENSOR
    select ADC
    help
      Sensor driver for the "mck,aaa-battery" devicetree node. Reads the
      battery voltage through a voltage divider (same wiring as ZMK's
      zmk,battery-voltage-divider) and converts it to percent with a NiMH
      (eneloop) curve per cell. Use it as the zmk,battery chosen node with
      CONFIG_ZMK_BATTERY_REPORTING_FETCH_MODE_STATE_OF_CHARGE=y.

DT_COMPAT_MCK_IQS5XX := mck,iqs5xx

config MCK_IQS5XX
    bool "Azoteq IQS5xx trackpad (mck,iqs5xx)"
    default $(dt_compat_enabled,$(DT_COMPAT_MCK_IQS5XX))
    depends on GPIO
    depends on I2C
    depends on INPUT
    help
      Input driver for the "mck,iqs5xx" devicetree node (Azoteq IQS5xx trackpads
      such as GR-Trackpad65 / TPS65 / TPS43). Reports REL_X / REL_Y, two finger
      scroll as REL_WHEEL / REL_HWHEEL and taps as BTN_0 / BTN_1.

if MCK_IQS5XX

config MCK_IQS5XX_BLOCK_READ
    bool "Read the status registers in one I2C transaction"
    default y
    help
      Read gesture events, system info, the finger count and the relative
      movement (0x000D..0x0015) in one transaction on every RDY event,
      instead of one transaction per register.

config MCK_IQS5XX_FINGER_DATA
    bool
    help
      Read the absolute data of fingers 1-5 (0x0016..0x0038) with the status.

config MCK_IQS5XX_GESTURES
    bool "3 / 4 finger taps and swipes"
    depends on MCK_IQS5XX_BLOCK_READ
    select MCK_IQS5XX_FINGER_DATA
    default y
    help
      Detect 3 / 4 finger taps and swipes from the fingers' absolute data
      (the IC has no gestures for more than 2 fingers) and press their key
      positions (gesture-positions, entries 2-11). While 3 or more fingers
      are down, no cursor movement, scroll or IC tap is reported. Only
      active when gesture-positions has an entry for the 3 finger tap.

if MCK_IQS5XX_GESTURES

config MCK_IQS5XX_GESTURE_TAP_MS
    int "Longest touch that counts as a 3 / 4 finger tap (ms)"
    default 400

config MCK_IQS5XX_GESTURE_TAP_MOVE
    int "Most the fingers may move for a 3 / 4 finger tap (trackpad units)"
    default 80

config MCK_IQS5XX_GESTURE_SWIPE_DIST
    int "Distance the fingers move for a 3 / 4 finger swipe (trackpad units)"
    default 200

config MCK_IQS5XX_GESTURE_SWIPE_SETTLE_MS
    int "Wait after the first finger before a swipe, so the finger count settles (ms)"
    default 100

config MCK_IQS5XX_GESTURE_SWIPE_MAX_MS
    int "No swipe after the touch has lasted this long (ms)"
    default 1000

endif # MCK_IQS5XX_GESTURES

config MCK_IQS5XX_MOTION
    bool "Cursor correction, acceleration, inertia and scroll only"
    depends on MCK_IQS5XX_BLOCK_READ
    default y
    help
      Process the one finger movement and the two finger scroll before they
      are reported: correction (average of the last moves), acceleration,
      inertia when the fingers are lifted, and scroll only (one finger
      scrolls; &tp_scroll swaps it while held). The defaults below turn
      everything off, which reports the movement as before.

if MCK_IQS5XX_MOTION

config MCK_IQS5XX_CORRECTION
    int "Correction: average of the last N moves (1 = off)"
    range 1 9
    default 1

config MCK_IQS5XX_ACCEL
    int "Acceleration strength (0 = off, 1-9)"
    range 0 9
    default 0
    help
      Faster moves are multiplied more: up to 1 + strength * 2 / 9 times
      (strength 9: 3 times) for a speed of 32 or more per 15 ms (one IC
      report; a slow move is reported less often, so the speed is per time).

config MCK_IQS5XX_INERTIA_CURSOR
    int "Cursor inertia length (0 = off, 1-9)"
    range 0 9
    default 0
    help
      After a quick one finger move is lifted (the last move within 40 ms),
      the cursor keeps moving at the speed of the moves in the last 45 ms and
      slows down by 1 - 1 / (1 + length) each step
      (MCK_IQS5XX_INERTIA_INTERVAL_MS): fast at first, then gently to a stop,
      about (1 + length) times the first step in all. Touching the trackpad
      stops it.

config MCK_IQS5XX_INERTIA_SCROLL
    int "Scroll inertia length (0 = off, 1-9)"
    range 0 9
    default 0
    help
      Same as the cursor inertia, for two finger scroll (and scroll only).

config MCK_IQS5XX_SCROLL_ONLY
    bool "Scroll only: one finger scrolls instead of moving the cursor"

config MCK_IQS5XX_INERTIA_INTERVAL_MS
    int "Time between two inertia reports (ms)"
    default 15

config MCK_IQS5XX_INERTIA_MIN_SPEED
    int "Slowest speed (trackpad units per inertia step) that starts inertia"
    default 6

config MCK_IQS5XX_LIFT_HOLD
    bool "Drop the slow cursor moves of the moment the finger lifts"
    default y
    help
      A finger rolls as it lifts, and the last 1-2 IC events move the cursor
      by a few units (it jumps off a button it was slowly brought onto).
      Slow moves (each axis <= MCK_IQS5XX_LIFT_HOLD_MAX) wait
      MCK_IQS5XX_LIFT_HOLD_EVENTS events (about 15 ms each) and are dropped
      if the finger lifts first. Faster moves are reported at once.

config MCK_IQS5XX_LIFT_HOLD_MAX
    int "Largest move per IC event (each axis) that waits"
    depends on MCK_IQS5XX_LIFT_HOLD
    default 8

config MCK_IQS5XX_LIFT_HOLD_EVENTS
    int "How many IC events a slow move waits"
    depends on MCK_IQS5XX_LIFT_HOLD
    range 1 3
    default 2

config MCK_IQS5XX_TAP_DRAG
    bool "Tap and drag (can be turned on through mck__trackpad)"
    default y
    help
      A one finger touch that starts soon after a one finger tap and moves
      (or stays) keeps the one finger tap's key position (BTN_0 without
      gesture-positions) pressed until the finger lifts. A second touch that
      lifts at once stays a tap (a double click). Whether it is on is a
      movement setting (tap_drag), MCK_IQS5XX_TAP_DRAG_ON at first.

config MCK_IQS5XX_TAP_DRAG_ON
    bool "Tap and drag is on at first"
    depends on MCK_IQS5XX_TAP_DRAG

config MCK_IQS5XX_TAP_DRAG_WINDOW_MS
    int "A touch within this many ms of a tap may become a drag"
    depends on MCK_IQS5XX_TAP_DRAG
    default 250

config MCK_IQS5XX_TAP_DRAG_MOVE
    int "It becomes a drag after moving this much (IC units, |x| + |y| summed)"
    depends on MCK_IQS5XX_TAP_DRAG
    default 10

config MCK_IQS5XX_TAP_DRAG_HOLD_MS
    int "Or after staying this many ms"
    depends on MCK_IQS5XX_TAP_DRAG
    default 150

config MCK_IQS5XX_MOTION_LOG
    bool "Log every move report and inertia step for tuning"
    help
      Log, at the info level, one line per cursor / scroll report ("m <kind>
      <ms since the last line> <IC move x y> <reported move x y>"), what the
      lift saw for the inertia, and each inertia step. For a USB logging build.

config MCK_TRACKPAD_SETTINGS
    bool "Keep the movement settings in flash (mck/tp/motion)"
    depends on SETTINGS
    default y
    help
      The settings changed at runtime (mck__trackpad) are saved and used again
      after a power off or a firmware update. settings_reset clears them.

config MCK_TRACKPAD_SAVE_DELAY_MS
    int "Wait after a change before saving it (ms), so many changes write once"
    depends on MCK_TRACKPAD_SETTINGS
    default 1000

config MCK_TRACKPAD_STUDIO_RPC
    bool "Change the movement settings over the custom ZMK Studio RPC (mck__trackpad)"
    depends on ZMK_STUDIO && MCK_TRACKPAD_SETTINGS
    default y

endif # MCK_IQS5XX_MOTION

DT_COMPAT_MCK_BEHAVIOR_TP_SCROLL := mck,behavior-tp-scroll

config MCK_BEHAVIOR_TP_SCROLL
    bool "&tp_scroll: scroll with one finger while held"
    default $(dt_compat_enabled,$(DT_COMPAT_MCK_BEHAVIOR_TP_SCROLL))
    depends on MCK_IQS5XX_MOTION

config MCK_IQS5XX_TOUCH_LOG
    bool "Log every touch (finger count, duration, movement) for tuning"
    depends on MCK_IQS5XX_BLOCK_READ
    select MCK_IQS5XX_FINGER_DATA
    help
      Also read the absolute data of fingers 1-5 (0x0016..0x0038) and log,
      at the info level, when the finger count changes and a summary when
      all fingers are lifted: the most fingers, how long, how far their
      center moved and the gestures the IC reported. For a USB logging
      build, to choose the values of the 3 / 4 finger gestures.

config MCK_IQS5XX_KEEP_SLOW_MOVES
    bool "Keep the moves of a slow touch that the IC briefly calls stationary"
    default y
    help
      The cursor (and scroll only) use a move only when the IC sets
      TP_MOVEMENT. In a slow move it comes and goes, and dropping those moves
      makes the cursor stutter as it slows down. With this, a move without
      TP_MOVEMENT is still used when at least 2 of the last 4 events of the
      touch had it. A resting finger rarely has it, so it still moves nothing.

config MCK_IQS5XX_EVENT_LOG
    bool "Log every IC event (moves, flags, finger 1 position) for tuning"
    depends on MCK_IQS5XX_BLOCK_READ
    select MCK_IQS5XX_FINGER_DATA
    help
      One line per event, at the info level: "e <ms since the last event>
      <fingers> <system info 1> <gesture events 0> <gesture events 1>
      <relative x y> <finger 1 absolute x y>", also for the events the cursor
      does not use (no TP_MOVEMENT). For a USB logging build, to see how slow
      moves arrive.

config MCK_IQS5XX_IC_TUNING
    bool "Change some values of the IC itself at runtime (slow moves, taps)"
    default y
    help
      The stationary touch threshold, the dynamic XY filter (bottom beta,
      lower speed), the idle touch rate and the tap time of the IQS5xx can
      be changed through mck__trackpad (MCK_TRACKPAD_STUDIO_RPC) and are
      saved in "mck/tp/ic". They are written in the IC's next communication
      window (the next touch). Until changed, the IC keeps its own values.

endif # MCK_IQS5XX

endmenu
```

## dts/bindings/input/mck,iqs5xx.yaml
```yaml
# Azoteq IQS5xx trackpad (IQS550 / IQS572 / IQS525), I2C.
# Driver: src/trackpad/iqs5xx.c (MIT, Mariano Uvalle + changes for the GRT65W / MCK).
# Same properties as azoteq,iqs5xx in zmk-config-grt65w (2026-11-25 D-136 T1 moved it here).

description: |
  Azoteq IQS5xx trackpad, using the I2C interface. The driver keeps the module's
  own (non-volatile) tuning and only touches the bits it needs.

compatible: "mck,iqs5xx"

include: i2c-device.yaml

properties:
  rdy-gpios:
    type: phandle-array
    required: true
    description: "Data Ready pin (the driver reads on its rising edge)"

  reset-gpios:
    type: phandle-array
    description: "Reset pin"

  one-finger-tap:
    type: boolean
    description: "Register single finger tap gestures and report them as a left click"

  press-and-hold:
    type: boolean
    description: "Register press and hold gestures and report them as a left click until released"

  press-and-hold-time:
    type: int
    description: "Time in ms (in addition to the tap time) it takes to register a press and hold gesture"
    default: 250

  two-finger-tap:
    type: boolean
    description: "Register two finger tap gestures and report them as a right click"

  scroll:
    type: boolean
    description: "Register and report scroll gestures, both vertical and horizontal scroll is supported"

  natural-scroll-x:
    type: boolean
    description: "Whether content should track finger movement when scrolling on the x axis."

  natural-scroll-y:
    type: boolean
    description: "Whether content should track finger movement when scrolling on the y axis."

  switch-xy:
    type: boolean
    description: "Swap the x and y axes"

  flip-x:
    type: boolean
    description: "Invert the direction of the x axis"

  flip-y:
    type: boolean
    description: "Invert the direction of the y axis"

  bottom-beta:
    type: int
    description: |
      Amount of filtering applied at slow speeds (0: most filtering, 255: least).
      No default: when omitted, the module's own value is kept.

  stationary-threshold:
    type: int
    description: |
      How far a finger must move (in pixels) to not be considered stationary.
      No default: when omitted, the module's own value is kept.

  # MCK: 2026-11-25 (D-136 T2)
  gesture-positions:
    type: array
    description: |
      Key positions (in the keymap) that the gestures press, so that what a gesture does
      is set per layer in the keymap and can be changed in ZMK Studio. The positions must
      exist in the matrix transform / physical layout (e.g. extra rows that the kscan
      never reports). In this order (an entry may be left out from the end):
        0: one finger tap     1: two finger tap
        2: three finger tap   3: four finger tap
        4-7: three finger swipe up, right, down, left
        8-11: four finger swipe up, right, down, left
      The driver presses the position and releases it gesture-release-ms later.
      Gestures without a position keep the old behavior (one / two finger tap are
      reported as BTN_0 / BTN_1). Three / four finger gestures are not detected yet.

  gesture-release-ms:
    type: int
    default: 100
    description: "How long (ms) a gesture keeps its key position pressed"
```

## dts/bindings/sensor/mck,aaa-battery.yaml
```yaml
# Based on zmk,battery-voltage-divider.yaml
# Copyright (c) 2020 The ZMK Contributors
# Copyright (c) 2026 mare-cycles
# SPDX-License-Identifier: MIT

description: |
  AAA (NiMH) battery level from a voltage divider. Same wiring and properties as
  zmk,battery-voltage-divider; only the voltage-to-percent curve differs.

compatible: "mck,aaa-battery"

include: voltage-divider.yaml

properties:
  cells:
    type: int
    default: 1
    description: |
      Number of cells in series. The NiMH curve is applied to the voltage per
      cell (1 for "one AAA + boost converter", 2 for two AAA in series).
```
